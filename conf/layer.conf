## conf/layer.conf
```bitbake
# We have a conf and classes directory, add to BBPATH
BBPATH .= ":${LAYERDIR}"

# We have recipes-* directories, add to BBFILES
BBFILES += "${LAYERDIR}/recipes-*/*/*.bb \
	${LAYERDIR}/recipes-*/*/*.bbappend"

BBFILE_COLLECTIONS += "meta-terranet"
BBFILE_PATTERN_meta-terranet = "^${LAYERDIR}/"
BBFILE_PRIORITY_meta-terranet = "9"

#LAYERDEPENDS_meta-terranet = "meta-freescale"
```

## conf/machine/terranet.conf
```bitbake
require conf/machine/imx6qdlsabresd.conf

KERNEL_DEVICETREE = " \
    imx6q-forlinx-hdmi.dtb imx6q-forlinx-lvds.dtb imx6q-forlinx.dtb\
"
KERNEL_DEVICETREE_use-mainline-bsp = " \
    imx6q-forlinx.dtb \
"

#UBOOT_CONFIG ??= "sd"
#UBOOT_CONFIG[sd] = "mx6qpsabresd_config,sdcard"
#UBOOT_CONFIG[sata] = "mx6qpsabresd_sata_config"
#UBOOT_CONFIG[mfgtool] = "mx6qpsabresd_config"
MACHINE_EXTRA_RRECOMMENDS += "firmware-imx-brcm"

UBOOT_MACHINE ?= "mx6sabresd_defconfig"
UBOOT_MAKE_TARGET = "all"
UBOOT_SUFFIX = "img"
SPL_BINARY = "SPL"
WKS_FILE = "imx-uboot-spl-bootpart.wks"

SERIAL_CONSOLE = "115200 ttymxc0"

MACHINE_FIRMWARE_append = " linux-firmware-ath6k"

MACHINE_FEATURES += " pci wifi bluetoothi ipv6 usbhost"

PREFERRED_PROVIDER_virtual/kernel ?= "linux-terranet"
IMAGE_FSTYPES = "tar.bz2 ext4 sdcard"
INHERIT += "buildhistory"
KERNEL_MODULE_AUTOLOAD += "rtl8822be"
```
